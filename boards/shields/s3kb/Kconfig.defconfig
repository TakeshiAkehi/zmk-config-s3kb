## boards/shields/s3kb/Kconfig.defconfig
```kconfig
# Copyright (c) 2021 The ZMK Contributors
# SPDX-License-Identifier: MIT

if SHIELD_S3KB_FRONT
    config ZMK_KEYBOARD_NAME
        default "s3kbd"
    config ZMK_SPLIT_ROLE_CENTRAL
        default y
endif


if SHIELD_S3KB_BACK || SHIELD_S3KB_FRONT
    config ZMK_SPLIT
        default y
endif
```

## boards/shields/s3kb/Kconfig.shield
```kconfig
# Copyright (c) 2021 The ZMK Contributors
# SPDX-License-Identifier: MIT

config SHIELD_S3KB_BACK
    def_bool $(shields_list_contains,s3kb_back)

config SHIELD_S3KB_FRONT
    def_bool $(shields_list_contains,s3kb_front)
```
